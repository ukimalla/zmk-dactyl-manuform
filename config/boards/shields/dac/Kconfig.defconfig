## config/boards/shields/dac/Kconfig.defconfig
```kconfig
# Copyright (c) 2022 The ZMK Contributors
# SPDX-License-Identifier: MIT

if SHIELD_DAC_LEFT

	config ZMK_KEYBOARD_NAME
	    default "DAC_LEFT"

	config ZMK_SPLIT_ROLE_CENTRAL
	    default y

endif

if SHIELD_DAC_LEFT

	config ZMK_KEYBOARD_NAME
	    default "DAC_RIGHT"

endif


if SHIELD_DAC_LEFT || SHIELD_DAC_RIGHT

	config ZMK_SPLIT
	    default y

endif
```

## config/boards/shields/dac/Kconfig.shield
```kconfig
# Copyright (c) 2022 The ZMK Contributors
# SPDX-License-Identifier: MIT

config SHIELD_DAC_LEFT
    def_bool $(shields_list_contains,dac_left)

config SHIELD_DAC_RIGHT
    def_bool $(shields_list_contains,dac_right)
```
